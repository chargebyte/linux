// SPDX-License-Identifier: GPL-2.0
/*
 * Copyright (C) 2025 chargebyte GmbH
 * Author: Stefan Wahren <stefan.wahren@chargebyte.com>
 */

#include <dt-bindings/gpio/gpio.h>
#include "imx93-pinfunc.h"

/dts-v1/;
/plugin/;

/ {
	compatible = "chargebyte,imx93-charge-som";
};

&iomuxc {
	pinctrl_clko_gpio: clkogpiogrp {
		fsl,pins = <
			MX93_PAD_CCM_CLKO1__GPIO3_IO26		0x31e
			MX93_PAD_CCM_CLKO2__GPIO3_IO27		0x31e
		>;
	};
};

&lpuart7 {
	pinctrl-names = "default";
	pinctrl-0 = <&pinctrl_clko_gpio>;
	status = "okay";
};
