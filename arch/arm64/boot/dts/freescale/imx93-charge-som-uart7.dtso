// SPDX-License-Identifier: GPL-2.0
/*
 * Copyright (C) 2025 chargebyte GmbH
 * Author: Stefan Wahren <stefan.wahren@chargebyte.com>
 */

#include <dt-bindings/gpio/gpio.h>
#include "imx93-pinfunc.h"

/dts-v1/;
/plugin/;

/ {
	compatible = "chargebyte,imx93-charge-som";
};

&iomuxc {
	pinctrl_uart7: uart7grp {
		fsl,pins = <
			MX93_PAD_GPIO_IO09__LPUART7_RX		0x31e // drive strength: X4, slew rate: slightly fast, pull up
			MX93_PAD_GPIO_IO08__LPUART7_TX		0x30e // drive strength: X3, slew rate: slightly fast, pull up
		>;
	};
};

&lpuart7 {
	pinctrl-names = "default";
	pinctrl-0 = <&pinctrl_uart7>;
	status = "okay";
};
