## Documentation/devicetree/bindings/phy/microchip,mcp256x-can.yaml
```yaml
# SPDX-License-Identifier: (GPL-2.0-only OR BSD-2-Clause)
%YAML 1.2
---
$id: http://devicetree.org/schemas/phy/microchip,mcp256x-can.yaml#
$schema: http://devicetree.org/meta-schemas/core.yaml#

title: MCP256x CAN TRANSCEIVER PHY

maintainers:
  - Stefan Wahren <wahrenst@gmx.net>

properties:
  $nodename:
    pattern: "^can-phy"

  compatible:
    enum:
      - microchip,mcp2561
      - microchip,mcp2562

  '#phy-cells':
    const: 0

  standby-gpios:
    description:
      gpio node to toggle standby signal on transceiver
    maxItems: 1

  max-bitrate:
    $ref: /schemas/types.yaml#/definitions/uint32
    description:
      max bit rate supported in bps
    minimum: 1

required:
  - compatible
  - '#phy-cells'

additionalProperties: false

examples:
  - |
    #include <dt-bindings/gpio/gpio.h>

    transceiver1: can-phy {
      compatible = "microchip,mcp2561";
      #phy-cells = <0>;
      max-bitrate = <5000000>;
      standby-gpios = <&wakeup_gpio1 16 GPIO_ACTIVE_LOW>;
    };
```

## drivers/mxc/hantro/Kconfig
```kconfig
#
# Codec configuration
#

menu "MXC HANTRO(Video Processing Unit) support"
	depends on ARCH_MXC

config MXC_HANTRO
	tristate "Support for MXC HANTRO(Video Processing Unit)"
	help
	  VPU codec device.

endmenu
```
